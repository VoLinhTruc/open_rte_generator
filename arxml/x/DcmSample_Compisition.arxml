AUTOSAR XML (schema 00047)
package /RB/PT/RBM/PCT_DASwCpt
  composition sw component type DcmSample
    component CPT_DcmSample_Provide: type=DcmSample_Provider
    component CPT_DcmSample_Requirer: type=DcmSample_Requirer
