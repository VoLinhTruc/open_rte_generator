AUTOSAR XML (schema 00049)
package /RB/UBK/Project/EcucModuleConfigurationValuess
  module config Rte
    5 x RteSwComponentInstance:
      CPT_DcmSample_Provider: RteSoftwareComponentInstanceRef=CPT_DcmSample_Provider
        TE_DcmSample_Provider_TE1 (RteEventToTaskMapping):
          RteActivationOffset = 0.0
          RteImmediateRestart = false
          RteOsSchedulePoint = CONDITIONAL
          RtePositionInTask = 14
          RteEventRef = TE_DcmSample_Provider_TE1
          RteMappedToTaskRef = OS_1Q1_1000ms_Task
      CPT_DcmSample_Requester: RteSoftwareComponentInstanceRef=CPT_DcmSample_Requester
        TE_DcmSample_Requester_TE1 (RteEventToTaskMapping):
          RteActivationOffset = 0.0
          RteImmediateRestart = false
          RteOsSchedulePoint = CONDITIONAL
          RtePositionInTask = 15
          RteEventRef = TE_DcmSample_Requester_TE1
          RteMappedToTaskRef = OS_1Q1_1000ms_Task
      CPT_ASW1: RteSoftwareComponentInstanceRef=CPT_ASW1
        TE_ASW1_TE1 (RteEventToTaskMapping):
          RteActivationOffset = 0.0
          RteImmediateRestart = false
          RteOsSchedulePoint = CONDITIONAL
          RtePositionInTask = 16
          RteEventRef = TE_ASW1_TE1
          RteMappedToTaskRef = OS_1Q1_10ms_Task
      CPT_ASW2: RteSoftwareComponentInstanceRef=CPT_ASW2
        TE_ASW2_TE1 (RteEventToTaskMapping):
          RteActivationOffset = 0.0
          RteImmediateRestart = false
          RteOsSchedulePoint = CONDITIONAL
          RtePositionInTask = 17
          RteEventRef = TE_ASW2_TE1
          RteMappedToTaskRef = OS_1Q1_10ms_Task
      CPT_ASW3: RteSoftwareComponentInstanceRef=CPT_ASW3
        TE_ASW3_TE1 (RteEventToTaskMapping):
          RteActivationOffset = 0.0
          RteImmediateRestart = false
          RteOsSchedulePoint = NONE
          RtePositionInTask = 28
          RteEventRef = TE_ASW3_TE1
          RteMappedToTaskRef = OS_1Q1_10ms_Task
