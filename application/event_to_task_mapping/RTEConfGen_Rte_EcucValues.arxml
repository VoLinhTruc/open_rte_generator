AUTOSAR XML (schema 00049)
package /RB/UBK/Project/EcucModuleConfigurationValuess
  module config Rte
    CPT_DcmSample_Provider (RteSwComponentInstance): RteSoftwareComponentInstanceRef=CPT_DcmSample_Provider
      TE_DcmSample_Provider_TE1 (RteEventToTaskMapping):
        RteActivationOffset = 0.0
        RteImmediateRestart = false
        RteOsSchedulePoint = CONDITIONAL
        RtePositionInTask = 14
        RteEventRef = TE_DcmSample_Provider_TE1
        RteMappedToTaskRef = OS_1Q1_1000ms_Task
    CPT_DcmSample_Requester (RteSwComponentInstance): RteSoftwareComponentInstanceRef=CPT_DcmSample_Requester
      TE_DcmSample_Requester_TE1 (RteEventToTaskMapping):
        RteActivationOffset = 0.0
        RteImmediateRestart = false
        RteOsSchedulePoint = CONDITIONAL
        RtePositionInTask = 15
        RteEventRef = TE_DcmSample_Requester_TE1
        RteMappedToTaskRef = OS_1Q1_1000ms_Task
