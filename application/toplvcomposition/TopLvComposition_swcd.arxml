AUTOSAR XML (schema 4-0-3)
package /RB/PT/PCT_TopLvlComposition/SwComponentTypes
  composition sw component type TopLvlComposition
    component CPT_DcmSample_Provider: type=DcmSample_Provider
    component CPT_DcmSample_Requester: type=DcmSample_Requester
    connect CPT_DcmSample_Requester.PP_DcmSample_Requester_PP1 -> CPT_DcmSample_Provider.RP_DcmSample_Provider_RP1
    connect CPT_DcmSample_Provider.PP_DcmSample_Provider_PP1 -> CPT_DcmSample_Requester.RP_DcmSample_Requester_RP1
