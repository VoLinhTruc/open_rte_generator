AUTOSAR XML (schema 4-2-2)
package /RB/UBK/Project/EcucModuleConfigurationValuess
  module config Os
    OS_1Q1_1000ms_Task (OsTask):
      OsTaskActivation = 1
      OsTaskCanCallSchedule = true
      OsTaskPriority = 4
      OsTaskSchedule = FULL
      OsTaskAccessingApplication = OsApp_1_Q_1
      OsTaskAccessingApplication = OsApp_2_Q_1
      OsTaskAccessingApplication = OsApp_0_Q_1
      OsTaskResourceRef = OS_RES_COOP_ASW1
    OS_1Q1_10ms_Task (OsTask):
      OsTaskActivation = 1
      OsTaskCanCallSchedule = true
      OsTaskPriority = 20
      OsTaskSchedule = FULL
      OsTaskAccessingApplication = OsApp_1_Q_1
      OsTaskAccessingApplication = OsApp_2_Q_1
      OsTaskAccessingApplication = OsApp_0_Q_1
