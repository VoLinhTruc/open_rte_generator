AUTOSAR XML (schema 00049)
package /SwComponentTypes
  composition sw component type ASW_TopLvlComposition
    5 x component:
      CPT_DcmSample_Provider: type=DcmSample_Provider
      CPT_DcmSample_Requester: type=DcmSample_Requester
      CPT_ASW{1..3}: type=ASW{1..3}
    connect CPT_DcmSample_Requester.PP_DcmSample_Requester_PP1 -> CPT_DcmSample_Provider.RP_DcmSample_Provider_RP1
    connect CPT_DcmSample_Provider.PP_DcmSample_Provider_PP1 -> CPT_DcmSample_Requester.RP_DcmSample_Requester_RP1
    connect CPT_ASW1.PP_ASW1_PP1 -> CPT_ASW2.RP_ASW2_RP1
    connect CPT_ASW2.PP_ASW2_PP1 -> CPT_ASW1.RP_ASW1_RP1
    connect CPT_ASW1.PP_ASW1_PP2 -> CPT_ASW3.RP_ASW3_RP1
    connect CPT_ASW3.PP_ASW3_PP1 -> CPT_ASW1.RP_ASW1_RP2
    connect CPT_ASW3.PP_ASW3_PP2 -> CPT_ASW2.RP_ASW2_RP2
    connect CPT_ASW2.PP_ASW2_PP2 -> CPT_ASW3.RP_ASW3_RP2
