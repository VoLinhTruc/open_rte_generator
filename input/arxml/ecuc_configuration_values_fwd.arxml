AUTOSAR XML (schema 00049)
package /RB/UBK/Project/EcucModuleConfigurationValuess
  module config CanTrcv
    esc_stack_cfg
      esc_stackDTtable
        esc_stack_EventList_OS_1000ms_Task (esc_stackEventGen_Entry): esc_EventType=T, esc_TaskCycle=1000, esc_TaskMessRaster=1000ms, esc_VirtualTaskName=OS_1000ms_Task
          esc_stack_Event_1Q1_1000ms_T (esc_TaskListArr):
            esc_stack_Pop_Event = T_ESC_PopSampTime_Proc_1Q1_1000ms
            esc_stack_Push_Event = T_ESC_PushSampTime_TSync_Proc_1Q1_1000ms
            esc_stack_task_AppID = OsApp_1_Q_1
            esc_stack_task_EcucCoreID = 1
            esc_stack_taskname = OS_1Q1_1000ms_Task
        esc_stack_EventList_OS_10ms_Task (esc_stackEventGen_Entry): esc_EventType=T, esc_TaskCycle=10, esc_TaskMessRaster=10ms, esc_VirtualTaskName=OS_10ms_Task
          esc_stack_Event_1Q1_10ms_T (esc_TaskListArr):
            esc_stack_Pop_Event = T_ESC_PopSampTime_Proc_1Q1_10ms
            esc_stack_Push_Event = T_ESC_PushSampTime_TSync_Proc_1Q1_10ms
            esc_stack_task_AppID = OsApp_1_Q_1
            esc_stack_task_EcucCoreID = 1
            esc_stack_taskname = OS_1Q1_10ms_Task
